## Kconfig
```kconfig
mainmenu "Rageutils Configuration"

menu "General Bot Configuration"
config TOKEN
    string "Bot Token"
    default ""
    help
        Discord bot token.

config SERVER_ID
    int "Server ID"
    default ""
    help
        ID of the Discord server you want to deploy the bot on.

config DEFAULT_ROLE_ID
    int "Default role ID"
    default ""
    help
        The ID of the role you want to give to someone upon joining.

endmenu

menu "Commands"
config DEBUG_COMMANDS 
    bool "Enable debug commands"
    default n
    help
        Enable commands for debugging.

config RAGEBOARD
    bool "Enable Rageboard"
    default y
    help
        Enable Rageboard, the social media clone.

config TAGS
    bool "Enable tags"
    default y
    help
        Enable tags for sharing snippets of information.

config STICKERS
    bool "Enable sticker creation from a command"
    default y
    help
        Enable commands for creating stickers. Handy on mobile.

config PROFILES
    bool "Enable profile commands (DEPRECATED)"
    default n
    help
        Enable profile commands for creation of user profiles and viewing them. Deprecated due to somewhat complicated and unintuitive design. Turning it on does no harm.

if RAGEBOARD
menu "Rageboard settings"
    config RAGEBOARD_CHANNEL_ID
        int "Rageboard Channel ID"
        default ""
        help 
            Channel ID of the channel where Rageboard posts will be located.

endmenu
endif

if TAGS
menu "Tag settings"
    config TAGS_BANNED_ID
        int "Tag-banned user role ID"
        default ""
        help 
            Role ID of users who will be unable to create tags.

endmenu
endif

endmenu
```
